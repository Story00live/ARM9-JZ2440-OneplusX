/**
  *********************************************************************************************************
  * @File               : main.lds
  * @Author             : kang.yunjie
  * @version            : V1.0
  * @Date               : 2019-03-06 21:00:00
  * @Brief              : lds
  *********************************************************************************************************
  * @attention
  *
  *********************************************************************************************************
  */

OUTPUT_ARCH(arm)														/* 设置输出文件的体系架构 */
ENTRY(_start)															/* 设置入口地址全局符号 */
SECTIONS {															/* 输出文件内容布局 */
	.text		0x00000000	:				{ *(.text) }
	.rodata					:				{ *(.rodata) }
	.data		0x30000000	: AT(0x00000F40)	{ *(.data) }
	.bss						:				{ *(.bss) *(.COMMON) }
}

/********************************************** END OF FLEE **********************************************/
