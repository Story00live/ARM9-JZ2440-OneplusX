/**
  *********************************************************************************************************
  * @File               : main.lds
  * @Author             : kang.yunjie
  * @version            : V1.0
  * @Date               : 2019-03-06 21:00:00
  * @Brief              : lds
  *********************************************************************************************************
  * @attention
  *
  *********************************************************************************************************
  */

OUTPUT_ARCH(arm)														/* 设置输出文件的体系架构 */
ENTRY(_start)															/* 设置入口地址全局符号 */
SECTIONS {															/* 输出文件内容布局 */
	.text		0x00000000	:				{						/* .text段 */
		*(.text)
	}
	
	.rodata					:				{						/* .rodata段 */
		*(.rodata)
	}
	
	.data		0x30000000	: AT(0x00000F80)	{						/* .data段 */
		__data_start = .;												/* 重定位后data段起始地址 */
		*(.data)
		__data_end = .;												/* 重定位后data段结束地址 */
		
		__data_load_addr = LOADADDR(.data);								/* data段原起始地址 */
	}
	
	.bss						:				{						/* .bss段 */
		*(.bss)
		*(.COMMON)
	}
}

/********************************************** END OF FLEE **********************************************/
