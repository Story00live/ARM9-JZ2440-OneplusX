/**
  *********************************************************************************************************
  * @File               : main.lds
  * @Author             : kang.yunjie
  * @version            : V1.0
  * @Date               : 2019-03-06 21:00:00
  * @Brief              : lds
  *********************************************************************************************************
  * @attention
  *
  *********************************************************************************************************
  */

OUTPUT_ARCH(arm)														/* 设置输出文件的体系架构 */
ENTRY(_start)															/* 设置入口地址全局符号 */
SECTIONS {															/* 输出文件内容布局 */
	
	. = 0x00000000;													/* 指定初始地址 */
	
	. = ALIGN(4);														/* 当前地址4字节对齐 */
	.text					:				{						/* .text段 */
		*(.text)
	}
	
	. = ALIGN(4);														/* 当前地址4字节对齐 */
	.rodata					:				{						/* .rodata段 */
		*(.rodata)
	}
	
	. = 0x30000000;													/* SDRAM起始地址 */
	
	. = ALIGN(4);														/* 当前地址4字节对齐 */
	.data					: AT(0x00000FA0)	{						/* .data段 */
		__data_start = .;												/* 重定位后data段起始地址 */
		*(.data)
		__data_end = .;												/* 重定位后data段结束地址 */
		
		__data_load_addr = LOADADDR(.data);								/* data段原起始地址 */
	}
	
	. = ALIGN(4);														/* 当前地址4字节对齐 */
	.bss						:				{						/* .bss段 */
		__bss_start = .;												/* 重定位后bss段起始地址 */
		*(.bss)
		__bss_end = .;													/* 重定位后bss段结束地址 */
	}
	
	. = ALIGN(4);														/* 当前地址4字节对齐 */
	.comment					:				{						/* .comment段 */
		*(.COMMON)
	}
}

/********************************************** END OF FLEE **********************************************/
